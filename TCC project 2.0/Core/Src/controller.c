/*
 * controller.c
 *
 *  Created on: Oct 22, 2023
 *      Author: pedro
 */

#include "controller.h"

//--------------------
#include "main.h"
#include "usb_device.h"

#include <stdbool.h>
#include <stdio.h>
#include <ClarkeParkTransformation.h>
#include <ADC2VoltageValues.h>
//------------------
#define PI 3.141592654

float SineTableValues[] = {0.0000000,0.0087300,0.0174500,0.0261800,0.0349000,0.0436200,0.0523400,0.0610500,0.0697600,0.0784600,0.0871600,0.0958500,0.1045300,0.1132000,
		0.1218700,0.1305300,0.1391700,0.1478100,0.1564300,0.1650500,0.1736500,0.1822400,0.1908100,0.1993700,0.2079100,0.2164400,0.2249500,0.2334500,0.2419200,0.2503800,
		0.2588200,0.2672400,0.2756400,0.2840200,0.2923700,0.3007100,0.3090200,0.3173000,0.3255700,0.3338100,0.3420200,0.3502100,0.3583700,0.3665000,0.3746100,0.3826800,
		0.3907300,0.3987500,0.4067400,0.4146900,0.4226200,0.4305100,0.4383700,0.4462000,0.4539900,0.4617500,0.4694700,0.4771600,0.4848100,0.4924200,0.5000000,0.5075400,
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		-0.0784600,-0.0697600,-0.0610500,-0.0523400,-0.0436200,-0.0349000,-0.0261800,-0.0174500,-0.0087300,0.0000000};


char Tst[128] = "";


void PIDController_Init(PIController *pid){
	pid->prevError = 0.0f;
	pid->Phase = 0.0f;

	pid->prevFrequency = 0.0f;
	pid->Frequency = 0.0f;
}

float Sine(float phase){
	long unsigned int PhasePos;
	int n;

	if(phase > 360){
		n = phase/360;
		PhasePos = phase - 360*n;
	}else{
		PhasePos = phase;
	}
	PhasePos = PhasePos*2;

	return SineTableValues[PhasePos];
}



double Cossine(float phase){
	long unsigned int PhasePos;
	int n;

	if(phase > 360){
		n = phase/360;
		PhasePos = phase - 360*n;
	}else{
		PhasePos = phase;
	}


	if(phase + 90 > 360){
		PhasePos = phase - 270;
	}else{
		PhasePos = phase + 90;
	}

	PhasePos = PhasePos*2;

	return SineTableValues[PhasePos];
}

float PIDController_Update(PIController *pid, float measurement){
	float error = measurement;
	pid->Frequency = pid->Frequency + pid->T/2*(pid->prevError + error)*pid->Ki + pid->Kp*error;

	if(pid->Frequency > pid->limMax) pid->Frequency = pid->limMax;
	if(pid->Frequency < pid->limMin) pid->Frequency = pid->limMin;

	pid->prevError = error;

	return pid->Frequency;
}

float integrator(PIController *pid){

	pid->Phase = pid->Phase + pid->T/2 *(pid->Frequency + pid->prevFrequency);
   //calculate the phase integration from the frequency. phase = 1/s * frequency

	if(pid->Phase > 360) pid->Phase = 0;
	if(pid->Phase < 0)   pid->Phase = 0;
	//resets the phases wheneevr it passes the 360 mark

	pid->prevFrequency = pid->Frequency;
	//updates the PrevFrequency value

	return pid->Phase;
}


float AlphaBetaCalculation(float alpha, float beta, float phase){

	return  (beta * Sine(phase) - alpha*Cossine(phase)) * (-1);
}


float Deg2Rad(float degree){
	return degree * (PI/180.0);
}

void LowPassFilter_init(Filter *filt){
	double dt = filt->SampleRate; //Initializes dt value
	double RC = 1.0 / (2.0 * PI * filt->cutOffFrequency); //finds the RC value

	filt->alpha = dt / (dt + RC); //calculates the alpha value for future calculations
}

double lowPassFilter(double input, Filter *filt) {

    filt->output = filt->alpha * input + (1 - filt->alpha) * filt->prevOutput;
    filt->prevOutput = filt->output;

    return filt->output;
}

void LowPassFilter2ndOrder_init(Filter2ndOrder *filt) {
    double dt = filt->SampleRate;        // Sampling time
    double omega = 2.0 * PI * filt->cutOffFrequency; // Angular frequency
    double zeta = 0.95; // Damping factor, can be adjusted


    // Calculate coefficients for the bilinear transform
    double A = omega * omega;
    double B = 2.0 * zeta * omega;
    double C = 4.0 / (dt * dt) + 2.0 * B / dt + A;
    double D = 2.0 * A - 8.0 / (dt * dt);
    double E = 4.0 / (dt * dt) - 2.0 * B / dt + A;

    // Normalize coefficients
    filt->a1 = A / C;
    filt->a2 = 2.0 * A / C;
    filt->a3 = filt->a1;
    filt->b1 = D / C;
    filt->b2 = E / C;
}

double lowPassFilter2ndOrder(double input, Filter2ndOrder *filt) {
    double output = filt->a1 * input + filt->a2 * filt->x1 + filt->a3 * filt->x2 - filt->b1 * filt->y1 - filt->b2 * filt->y2;

    // Update previous values for the next iteration
    filt->x2 = filt->x1;
    filt->x1 = input;
    filt->y2 = filt->y1;
    filt->y1 = output;

    return output;
}







